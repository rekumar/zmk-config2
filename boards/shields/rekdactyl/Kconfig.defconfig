## boards/shields/rekdactyl/Kconfig.defconfig
```kconfig
if SHIELD_REKDACTYL_LEFT

config ZMK_KEYBOARD_NAME
	default "REKDactyl"

config ZMK_SPLIT_ROLE_CENTRAL
	default y

endif


if SHIELD_REKDACTYL_RIGHT

config ZMK_KEYBOARD_NAME
	default "REKDactyl Right"

endif

if SHIELD_REKDACTYL_LEFT || SHIELD_REKDACTYL_RIGHT

config ZMK_SPLIT
	default y
 
endif
```

## boards/shields/rekdactyl/Kconfig.shield
```kconfig
# Copyright (c) 2020 Pete Johanson
# SPDX-License-Identifier: MIT

config SHIELD_REKDACTYL_LEFT
	def_bool $(shields_list_contains,rekdactyl_left)

config SHIELD_REKDACTYL_RIGHT
	def_bool $(shields_list_contains,rekdactyl_right)
```

## boards/shields/rekdactyl2/Kconfig.defconfig
```kconfig
if SHIELD_REKDACTYL2_LEFT

config ZMK_KEYBOARD_NAME
	default "REKDactyl2"

config ZMK_SPLIT_ROLE_CENTRAL
	default y

endif

if SHIELD_REKDACTYL2_RIGHT || SHIELD_REKDACTYL2_LEFT

config ZMK_SPLIT
	default y

endif

if SHIELD_REKDACTYL2_LEFT || SHIELD_REKDACTYL2_RIGHT

config ZMK_SPLIT
	default y

config ZMK_IDLE_SLEEP_TIMEOUT
	int "Milliseconds of inactivity before deep sleep. 15 minutes."
	default 900000

config ZMK_SLEEP
	default y

endif
```

## boards/shields/rekdactyl2/Kconfig.shield
```kconfig
# Copyright (c) 2020 Pete Johanson
# SPDX-License-Identifier: MIT

config SHIELD_REKDACTYL2_LEFT
	def_bool $(shields_list_contains,rekdactyl2_left)

config SHIELD_REKDACTYL2_RIGHT
	def_bool $(shields_list_contains,rekdactyl2_right)
```
