/*
 * Copyright (c) 2020 Pete Johanson
 *
 * SPDX-License-Identifier: MIT
 */

#include "rekdactyl2.dtsi"

&default_transform {
	col-offset = <5>;
};

&kscan0 {
	row-gpios
        = <&pro_micro_d 6 GPIO_ACTIVE_HIGH> // Row A from the schematic file
        , <&pro_micro_d 5 GPIO_ACTIVE_HIGH> // Row B from the schematic file
        , <&pro_micro_d 4 GPIO_ACTIVE_HIGH> // Row C from the schematic file
        , <&pro_micro_d 3 GPIO_ACTIVE_HIGH> // Row D from the schematic file
        ;
};




